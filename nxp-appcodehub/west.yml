## nxp-appcodehub/west.yml
```yaml
manifest:
  defaults:
    remote: zephyrproject-rtos

  remotes:
    - name: zephyrproject-rtos
      url-base: https://github.com/zephyrproject-rtos
    - name: wolfssl
      url-base: https://github.com/wolfssl
    - name: wolfmqtt
      url-base: https://github.com/wolfssl
    - name: wolfboot
      url-base: https://github.com/kojo1

  projects:
    - name: zephyr
      remote: zephyrproject-rtos
      revision: v4.4.0
      import:
        - name-allowlist:
          - hal_nxp
          - cmsis
          - cmsis_6
          - fatfs
          - segger
    - name: wolfssl
      path: modules/crypto/wolfssl
      revision: v5.9.1-stable
      remote: wolfssl
    - name: wolfmqtt
      path: modules/lib/wolfmqtt
      revision: v2.0.0
      remote: wolfssl
    - name: wolfboot
      path: modules/bootloader/wolfboot
      revision: v2.8.0
      remote: wolfboot
      submodules:
        - path: lib/wolfssl
```
